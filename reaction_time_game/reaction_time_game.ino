#include <LiquidCrystal.h>
#include <TimerOne.h>
LiquidCrystal LCD(10,9,5,4,3,2);

int button1 = 12;
int button2 = 13;
int LED = 8;

int ranDelay;
int single;
int multi;
float reactTime1;
float reactTime2;

void setup() {
  // put your setup code here, to run once:
  pinMode(button1, INPUT);        
  pinMode(button2, INPUT);
  pinMode(LED, OUTPUT);
  Serial.begin(9600);
  
  LCD.begin(16, 2);
  LCD.home();
  LCD.print("Reaction Time");
  LCD.setCursor(0, 1);
  LCD.print("Game");
}

void loop() {
  // put your main code here, to run repeatedly:

  //Press 1 for 1 player, 2 for 2 player
  single = digitalRead(button1);
  multi = digitalRead(button2);

  //Singleplayer
  if(single == 0 && multi == 1){
    LCD.clear();
    LCD.home();
    LCD.print("Singleplayer");
    delay(2000);
    LCD.clear();
    LCD.print("Get Ready!");

    ranDelay = random(5000);              //Randomly turns on LED between 1-5 sec interval
    delay(ranDelay);
    reactTime1 = millis();                //Initialize reaction time counter
    digitalWrite(LED, HIGH);

    while(digitalRead(button1) == 1){}    //Wait until button pressed
    reactTime1 = millis() - reactTime1;   //Calculate reaction time
    digitalWrite(LED, LOW);
    LCD.clear();
    LCD.home();
    LCD.print("Your Time:");
    LCD.setCursor(0, 1);
    LCD.print(reactTime1);
    LCD.print(" ms"); 
    delay(2000);                          //Display time, then wait for player to select modes again
  }
  else if(single == 1 && multi == 0){     //Multiplayer
    LCD.clear();
    LCD.home();
    LCD.print("Multiplayer");
    delay(2000);
    LCD.clear();
    LCD.print("Get Ready!");
    
    ranDelay = random(5000);              //Randomly turns on LED between 1-5 sec interval
    delay(ranDelay);
    reactTime1 = millis();
    reactTime2 = millis();
    digitalWrite(LED, HIGH);

    while(digitalRead(button1) == 1 && digitalRead(button2) == 1){} //Wait while neither button is pressed
    
    if(digitalRead(button1) == 0 && digitalRead(button2) == 1){     //If button 1 is pressed first
      reactTime1 = millis() - reactTime1;
      digitalWrite(LED, LOW);
      LCD.clear();
      LCD.home();
      LCD.print("Player 1 wins!");
      LCD.setCursor(0, 1);
      LCD.print("Time: ");
      LCD.print(reactTime1);
      LCD.print(" ms");
      delay(2000);                            //Display time, then wait for player to select modes again
    }
    else if(digitalRead(button2) == 0 && digitalRead(button1) == 1){  //If button 2 is pressed first
      reactTime1 = millis() - reactTime1;
      digitalWrite(LED, LOW);
      LCD.clear();
      LCD.home();
      LCD.print("Player 2 wins!");
      LCD.setCursor(0, 1);
      LCD.print(reactTime1);
      LCD.print(" ms");
      delay(2000);                          //Display time, then wait for player to select modes again
    }
  }
}
